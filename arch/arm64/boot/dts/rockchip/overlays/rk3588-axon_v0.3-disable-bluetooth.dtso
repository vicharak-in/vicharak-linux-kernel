/dts-v1/;
/plugin/;

#include <dt-bindings/gpio/gpio.h>
#include <dt-bindings/pinctrl/rockchip.h>
#include <dt-bindings/interrupt-controller/irq.h>

&{/} {
        metadata {
                title ="Disable RTL8852BS Bluetooth 5.2 support on Axon V0.3";
                compatible = "vicharak,rk3588-axon", "rockchip,rk3588";
                category = "misc";
                description = "This overlay disables Bluetooth 5.2 functionality on Axon for applications requiring higher security by preventing bluetooth communication from initializing.\n";
        };
};

&wireless_bluetooth {
	status = "disabled";
};

&uart9 {
	status = "disabled";
};
