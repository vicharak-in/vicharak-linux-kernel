// SPDX-License-Identifier: GPL-2.0+
// Copyright (C) 2023 Vicharak Computers LLP

/dts-v1/;
/plugin/;

#include <dt-bindings/gpio/gpio.h>
#include <dt-bindings/pinctrl/rockchip.h>

&{/} {
    metadata {
        title ="Enable PWM0_M0 on 30 Pin GPIO Header Axon V0.3";
        compatible = "vicharak,rk3588-axon", "rockchip,rk3588";
        category = "misc";
        exclusive = "pwm0", "GPIO1_D2";
        description = "Enable PWM0 on GPIO1_D2 (Pin 20)";
    };
};

&pwm0{
    status = "okay";
    pinctrl-names = "active";
	pinctrl-0 = <&pwm0m1_pins>;
};
