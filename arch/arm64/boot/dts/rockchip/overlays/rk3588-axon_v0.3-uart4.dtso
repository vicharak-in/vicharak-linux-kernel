// SPDX-License-Identifier: GPL-2.0+
// Copyright (C) 2023 Vicharak Computers LLP

/dts-v1/;
/plugin/;

#include <dt-bindings/gpio/gpio.h>
#include <dt-bindings/pinctrl/rockchip.h>

&{/} {
    metadata {
        title ="Enable UART4 on 30 Pin GPIO Header Axon V0.3";
        compatible = "vicharak,rk3588-axon", "rockchip,rk3588";
        category = "misc";
        exclusive = "uart4", "GPIO1_D2", "GPIO1_D3";
        description = "Enable UART4 on GPIO1_D2 (Pin 20) For Tx and GPIO1_D3 (Pin 19) For Rx";
    };
};

&uart4 {
    status = "okay";
    pinctrl-names = "default";
    pinctrl-0 = <&uart4m0_xfer>;
};
