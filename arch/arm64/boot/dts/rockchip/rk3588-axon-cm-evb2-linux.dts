// SPDX-License-Identifier: (GPL-2.0+ OR MIT)
/*
 * Copyright (C) 2026 Vicharak Computers Pvt. Ltd.

 Axon CM Evolution Board 2 (EVB2) Includes:

 - 1x Ethernet RGMII
 - 1x Audio Jack ES8388
 - 2x Audio Speaker ( Left and Right )
 - 1x HDMI Rx 2.0
 - 1x HDMI Tx 2.1
 - 1x MIPI DPHY0 Tx
 - 1x MIPI DPHY1 Tx
 - 1x MIPI DPHY0 Rx
 - 1x MIPI DPHY1 Rx
 - 2x MIPI CSI Rx
 - 2x Type C/DP
 - 1x PCIe 2.0
 - 1x SATA 3.0
 - 1x SDMMC
 - 1x PCIe 3.0 M.2 (NVMe) 4Lane
 - 4x SARADC Pin
 - 1x Button each for POWER, RESET and BOOT
 - 1x 5v connector
 - 1x 30 Pin GPIO Header
 - 1x Button each for POWER, RESET, RECOVERY and BOOT
 */

/dts-v1/;

#include "rk3588-axon-cm.dtsi"
#include "rk3588-axon-cm-evb2.dtsi"
#include "rk3588-linux.dtsi"
#include <dt-bindings/input/rk-input.h>

/ {
	model = "Vicharak RK3588 AXON CM EVB2 V0.1 R0.1 LINUX";
	compatible = "vicharak,rk3588-axon-cm-evb2", "rockchip,rk3588";

	/delete-node/ chosen;
	chosen: chosen {
		bootargs = "earlycon=uart8250,mmio32,0xfeb50000 console=ttyFIQ0 irqchip.gicv3_pseudo_nmi=0";
	};
};
