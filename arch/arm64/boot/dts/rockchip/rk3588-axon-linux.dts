// SPDX-License-Identifier: (GPL-2.0+ OR MIT)
/*
 * Copyright (C) 2023 Vicharak Computers LLP
 */

/dts-v1/;

#include "rk3588-axon.dtsi"
#include "rk3588-linux.dtsi"

/ {
	model = "Vicharak RK3588 AXON VO.2 LINUX";
	compatible = "vicharak,rk3588-axon", "rockchip,rk3588";

	/delete-node/ chosen;
	chosen: chosen {
		bootargs = "earlycon=uart8250,mmio32,0xfeb50000 console=ttyFIQ0 irqchip.gicv3_pseudo_nmi=0 coherent_pool=1m systemd.gpt_auto=0 cgroup_enable=memory swapaccount=1";
	};
};

