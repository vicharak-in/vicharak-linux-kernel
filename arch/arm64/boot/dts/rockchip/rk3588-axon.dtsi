// SPDX-License-Identifier: (GPL-2.0+ OR MIT)
/*
 * Copyright (C) 2023 Vicharak Computers LLP
 */

#include "rk3588.dtsi"
#include "rk3588-axon-rk806-single.dtsi"
#include <dt-bindings/display/rockchip_vop.h>
#include <dt-bindings/input/rk-input.h>
#include <dt-bindings/leds/common.h>
#include <dt-bindings/pinctrl/rockchip.h>
#include <dt-bindings/usb/pd.h>

/ {
	compatible = "vicharak,rk3588-axon", "rockchip,rk3588";

	aliases {
		mmc0 = &sdmmc;
		mmc1 = &sdhci;
		mmc2 = &sdio;
	};

	dp0_sound: dp0-sound {
		compatible = "rockchip,hdmi";
		rockchip,card-name= "rockchip-dp0";
		rockchip,mclk-fs = <512>;
		rockchip,cpu = <&spdif_tx2>;
		rockchip,codec = <&dp0 1>;
		rockchip,jack-det;
		status = "okay";
	};

	dp1_sound: dp1-sound {
		compatible = "rockchip,hdmi";
		rockchip,card-name= "rockchip-dp1";
		rockchip,mclk-fs = <512>;
		rockchip,cpu = <&spdif_tx5>;
		rockchip,codec = <&dp1 1>;
		rockchip,jack-det;
		status = "okay";
	};

	es8388_sound: es8388-sound {
		compatible = "rockchip,multicodecs-card";
		hp-con-gpio = <&gpio1 RK_PD5 GPIO_ACTIVE_HIGH>;
		hp-det-gpio = <&gpio1 RK_PC4 GPIO_ACTIVE_HIGH>;
		spk-con-gpio = <&gpio1 RK_PC6 GPIO_ACTIVE_HIGH>;
		io-channel-names = "adc-detect";
		io-channels = <&saradc 3>;
		keyup-threshold-microvolt = <1800000>;
		poll-interval = <100>;
		rockchip,audio-routing =
			"Headphone", "LOUT1",
			"Headphone", "ROUT1",
			"Speaker", "LOUT2",
			"Speaker", "ROUT2",
			"Headphone", "Headphone Power",
			"Headphone", "Headphone Power",
			"Speaker", "Speaker Power",
			"Speaker", "Speaker Power",
			"LINPUT1", "Main Mic",
			"LINPUT2", "Main Mic",
			"RINPUT1", "Headset Mic",
			"RINPUT2", "Headset Mic";
		rockchip,card-name = "rockchip-es8388";
		rockchip,codec = <&es8388>;
		rockchip,cpu = <&i2s0_8ch>;
		rockchip,format = "i2s";
		rockchip,mclk-fs = <256>;
		pinctrl-names = "default";
		pinctrl-0 = <&hp_det>;
		status = "okay";

		play-pause-key {
			label = "playpause";
			linux,code = <KEY_PLAYPAUSE>;
			press-threshold-microvolt = <2000>;
		};
	};

	hdmi0_sound: hdmi0-sound {
		compatible = "rockchip,hdmi";
		rockchip,mclk-fs = <128>;
		rockchip,card-name = "rockchip-hdmi0";
		rockchip,cpu = <&i2s5_8ch>;
		rockchip,codec = <&hdmi0>;
		rockchip,jack-det;
		status = "okay";
	};

	hdmi1_sound: hdmi1-sound {
		compatible = "rockchip,hdmi";
		rockchip,mclk-fs = <128>;
		rockchip,card-name = "rockchip-hdmi1";
		rockchip,cpu = <&i2s6_8ch>;
		rockchip,codec = <&hdmi1>;
		rockchip,jack-det;
		status = "okay";
	};

	hdmiin_sound: hdmiin-sound {
		compatible = "rockchip,hdmi";
		rockchip,mclk-fs = <128>;
		rockchip,format = "i2s";
		rockchip,bitclock-master = <&hdmirx_ctrler>;
		rockchip,frame-master = <&hdmirx_ctrler>;
		rockchip,card-name = "rockchip,hdmiin";
		rockchip,cpu = <&i2s7_8ch>;
		rockchip,codec = <&hdmirx_ctrler 0>;
		rockchip,jack-det;
	};

	keys {
		compatible = "adc-keys";
		io-channels = <&saradc 1>;
		io-channel-names = "buttons";
		keyup-threshold-microvolt = <1800000>;
		poll-interval = <100>;
		status = "okay";

		vol-up-key {
			label = "volume up";
			linux,code = <KEY_VOLUMEUP>;
			press-threshold-microvolt = <17000>;
		};

		vol-down-key {
			label = "volume down";
			linux,code = <KEY_VOLUMEDOWN>;
			press-threshold-microvolt = <417000>;
		};

		menu-key {
			label = "menu";
			linux,code = <KEY_MENU>;
			press-threshold-microvolt = <890000>;
		};

		back-key {
			label = "back";
			linux,code = <KEY_BACK>;
			press-threshold-microvolt = <1235000>;
		};
	};

	leds {
		compatible = "gpio-leds";
		status = "okay";

		power_led: power-led {
			function = LED_FUNCTION_POWER;
			gpios = <&pca9554 0 GPIO_ACTIVE_HIGH>;
			default-state = "on";
			retain-state-suspended;
			linux,default-trigger = "default-on";
		};

		status_led: status-led {
			function = LED_FUNCTION_STATUS;
			gpios = <&pca9554 1 GPIO_ACTIVE_HIGH>;
			default-state = "on";
			retain-state-suspended;
			linux,default-trigger = "heartbeat";
		};
	};

	pcie20_avdd0v85: pcie20-avdd0v85-regulator {
		compatible = "regulator-fixed";
		regulator-name = "pcie20_avdd0v85";
		regulator-boot-on;
		regulator-always-on;
		regulator-min-microvolt = <850000>;
		regulator-max-microvolt = <850000>;
		vin-supply = <&vdd_0v75_s0>;
	};

	pcie20_avdd1v8: pcie20-avdd1v8-regulator {
		compatible = "regulator-fixed";
		regulator-name = "pcie20_avdd1v8";
		regulator-boot-on;
		regulator-always-on;
		regulator-min-microvolt = <1800000>;
		regulator-max-microvolt = <1800000>;
		vin-supply = <&avcc_1v8_s0>;
	};

	pcie30_avdd0v75: pcie30-avdd0v75-regulator {
		compatible = "regulator-fixed";
		regulator-name = "pcie30_avdd0v75";
		regulator-boot-on;
		regulator-always-on;
		regulator-min-microvolt = <750000>;
		regulator-max-microvolt = <750000>;
		vin-supply = <&vdd_0v75_s0>;
	};

	pcie30_avdd1v8: pcie30-avdd1v8-regulator {
		compatible = "regulator-fixed";
		regulator-name = "pcie30_avdd1v8";
		regulator-boot-on;
		regulator-always-on;
		regulator-min-microvolt = <1800000>;
		regulator-max-microvolt = <1800000>;
		vin-supply = <&avcc_1v8_s0>;
	};

	reserved-memory {
		#address-cells = <2>;
		#size-cells = <2>;
		ranges;

		// Reserve 128MB memory for hdmirx-controller@fdee0000
		cma {
			compatible = "shared-dma-pool";
			reusable;
			reg = <0x0 (256 * 0x100000) 0x0 (128 * 0x100000)>;
			linux,cma-default;
		};
	};

	sata_vcc_5v0: sata-vcc-5v0 {
		compatible = "regulator-fixed";
		regulator-name = "sata_vcc_5v0";
		startup-delay-us = <5000>;
		regulator-boot-on;
		regulator-always-on;
		enable-active-high;
		regulator-min-microvolt = <5000000>;
		regulator-max-microvolt = <5000000>;
		vin-supply = <&vcc12v_dcin>;
	};

	sdio_pwrseq: sdio-pwrseq {
		compatible = "mmc-pwrseq-simple";
		clocks = <&hym8563>;
		clock-names = "ext_clock";
		pinctrl-names = "default";
		pinctrl-0 = <&sdio_reset_wifi>;
		reset-gpios = <&gpio4 RK_PC6 GPIO_ACTIVE_LOW>;
		status = "okay";
	};

	vbus5v0_typec0: vbus5v0-typec0-regulator {
		compatible = "regulator-fixed";
		regulator-name = "vbus5v0_typec0";
		regulator-boot-on;
		enable-active-high;
		regulator-min-microvolt = <5000000>;
		regulator-max-microvolt = <5000000>;
		gpio = <&pca9554 6 GPIO_ACTIVE_HIGH>;
		vin-supply = <&vcc1_5v0>;
	};

	vbus5v0_typec1: vbus5v0-typec1-regulator {
		compatible = "regulator-fixed";
		regulator-name = "vbus5v0_typec1";
		regulator-boot-on;
		enable-active-high;
		regulator-min-microvolt = <5000000>;
		regulator-max-microvolt = <5000000>;
		gpio = <&pca9554 4 GPIO_ACTIVE_HIGH>;
		vin-supply = <&vcc1_5v0>;
	};

	vcc12v_dcin: vcc12v-dcin-regulator {
		compatible = "regulator-fixed";
		regulator-name = "vcc12v_dcin";
		regulator-always-on;
		regulator-boot-on;
		regulator-min-microvolt = <12000000>;
		regulator-max-microvolt = <12000000>;
	};

	vcc0_4v0: vcc4v0_sys: vcc0-4v0-regulator {
		compatible = "regulator-fixed";
		regulator-name = "vcc0_4v0";
		regulator-always-on;
		regulator-boot-on;
		regulator-min-microvolt = <4000000>;
		regulator-max-microvolt = <4000000>;
		vin-supply = <&vcc12v_dcin>;
	};

	vcc1_5v0: vcc5v0_sys: vcc1-5v0-regulator {
		compatible = "regulator-fixed";
		regulator-name = "vcc1_5v0";
		regulator-always-on;
		regulator-boot-on;
		regulator-min-microvolt = <5000000>;
		regulator-max-microvolt = <5000000>;
		vin-supply = <&vcc12v_dcin>;
	};

	vcc_1v1_nldo_s3: vcc-1v1-nldo-s3-regulator {
		compatible = "regulator-fixed";
		regulator-name = "vcc_1v1_nldo_s3";
		regulator-always-on;
		regulator-boot-on;
		regulator-min-microvolt = <1100000>;
		regulator-max-microvolt = <1100000>;
		vin-supply = <&vcc1_5v0>;
	};

	vcc3v3_io_expander: vcc3v3-io-expander {
		compatible = "regulator-fixed";
		regulator-name = "vcc3v3_io_expander";
		regulator-boot-on;
		regulator-always-on;
		enable-active-high;
		regulator-min-microvolt = <3300000>;
		regulator-max-microvolt = <3300000>;
	};

	vcc3v3_pcie20_sata30: vcc3v3-pcie20-sata30 {
		compatible = "regulator-fixed";
		regulator-name = "vcc3v3_pcie20_sata30";
		regulator-boot-on;
		regulator-always-on;
		enable-active-high;
		gpios = <&gpio0 RK_PA0 GPIO_ACTIVE_HIGH>;
		regulator-max-microvolt = <3300000>;
		regulator-min-microvolt = <3300000>;
		vin-supply = <&vcc12v_dcin>;
	};

	vcc3v3_pcie30: vcc3v3-pcie30 {
		compatible = "regulator-fixed";
		regulator-name = "vcc3v3_pcie30";
		regulator-boot-on;
		regulator-always-on;
		enable-active-high;
		gpios = <&gpio0 RK_PB2 GPIO_ACTIVE_HIGH>;
		regulator-min-microvolt = <3300000>;
		regulator-max-microvolt = <3300000>;
		vin-supply = <&vcc12v_dcin>;
	};

	vcc5v0_usb20_host: vcc5v0-usb20-host-regulator {
		compatible = "regulator-fixed";
		regulator-name = "vcc5v0_usb20_host";
		regulator-boot-on;
		regulator-always-on;
		enable-active-high;
		regulator-min-microvolt = <5000000>;
		regulator-max-microvolt = <5000000>;
		vin-supply = <&vcc1_5v0>;
	};

	wireless_bluetooth: wireless-bluetooth {
		compatible = "bluetooth-platdata";
		clocks = <&hym8563>;
		clock-names = "ext_clock";
		uart_rts_gpios = <&gpio4 RK_PC4 GPIO_ACTIVE_LOW>;
		pinctrl-names = "default", "rts_gpio";
		pinctrl-0 = <&uart9m0_rtsn>, <&bt_reset_gpio>, <&bt_wake_gpio>,
					<&bt_irq_gpio>;
		pinctrl-1 = <&uart9_gpios>;
		BT,wake_host_irq = <&gpio0 RK_PC4 GPIO_ACTIVE_HIGH>;
		BT,wake_gpio     = <&gpio0 RK_PC5 GPIO_ACTIVE_HIGH>;
		BT,reset_gpio    = <&gpio0 RK_PC6 GPIO_ACTIVE_HIGH>;
		status = "okay";
	};

	wireless_wlan: wireless-wlan {
		compatible = "wlan-platdata";
		wifi_chip_type = "rtl8852bs";
		pinctrl-names = "default";
		pinctrl-0 = <&wifi_host_wake_irq>, <&wifi_poweren_gpio>;
		WIFI,host_wake_irq = <&gpio2 RK_PB4 GPIO_ACTIVE_HIGH>;
		WIFI,poweren_gpio = <&gpio2 RK_PB5 GPIO_ACTIVE_HIGH>;
		status = "okay";
	};
};

&gpio0 {
	gpio-line-names =
		/* GPIO0_A0-A3 */
		"", "", "", "",
		/* GPIO0_A4-A7 */
		"", "", "", "",
		/* GPIO0_B0-B3 */
		"", "", "", "",
		/* GPIO0_B4-B7 */
		"", "PIN_2", "PIN_4", "",
		/* GPIO0_C0-C3 */
		"PIN_13", "", "", "",
		/* GPIO0_C4-C7 */
		"", "", "", "",
		/* GPIO0_D0-D3 */
		"", "", "", "",
		/* GPIO0_D4-D7 */
		"", "", "", "";
};

&gpio1 {
	gpio-line-names =
		/* GPIO1_A0-A3 */
		"", "", "", "",
		/* GPIO1_A4-A7 */
		"", "", "", "",
		/* GPIO1_B0-B3 */
		"", "", "", "PIN_23",
		/* GPIO1_B4-B7 */
		"", "", "", "",
		/* GPIO1_C0-C3 */
		"", "", "", "",
		/* GPIO1_C4-C7 */
		"", "", "", "",
		/* GPIO1_D0-D3 */
		"PIN_17", "PIN_18", "PIN_20", "PIN_19",
		/* GPIO1_D4-D7 */
		"", "", "", "";
};

&gpio2 {
	gpio-line-names =
		/* GPIO2_A0-A3 */
		"", "", "", "",
		/* GPIO2_A4-A7 */
		"", "", "", "",
		/* GPIO2_B0-B3 */
		"", "", "", "",
		/* GPIO2_B4-B7 */
		"", "", "PIN_10", "PIN_12",
		/* GPIO2_C0-C3 */
		"PIN_11", "PIN_9", "", "",
		/* GPIO2_C4-C7 */
		"", "", "", "",
		/* GPIO2_D0-D3 */
		"", "", "", "",
		/* GPIO2_D4-D7 */
		"", "", "", "";
};

&gpio3 {
	gpio-line-names =
		/* GPIO3_A0-A3 */
		"", "", "", "",
		/* GPIO3_A4-A7 */
		"", "", "", "",
		/* GPIO3_B0-B3 */
		"", "", "", "",
		/* GPIO3_B4-B7 */
		"", "", "", "",
		/* GPIO3_C0-C3 */
		"", "", "", "",
		/* GPIO3_C4-C7 */
		"", "", "", "",
		/* GPIO3_D0-D3 */
		"", "", "", "",
		/* GPIO3_D4-D7 */
		"", "", "", "";
};

&gpio4 {
	gpio-line-names =
		/* GPIO4_A0-A3 */
		"", "", "", "",
		/* GPIO4_A4-A7 */
		"", "", "", "",
		/* GPIO4_B0-B3 */
		"", "", "", "",
		/* GPIO4_B4-B7 */
		"", "", "", "",
		/* GPIO4_C0-C3 */
		"", "", "", "",
		/* GPIO4_C4-C7 */
		"", "", "", "",
		/* GPIO4_D0-D3 */
		"", "", "", "",
		/* GPIO4_D4-D7 */
		"", "", "", "";
};

&av1d_mmu {
	status = "okay";
};

&avsd {
	status = "okay";
};

&combphy0_ps {
	status = "okay";
};

&combphy1_ps {
	status = "okay";
};

&combphy2_psu {
	status = "okay";
};

&cpu_b0 {
	cpu-supply = <&vdd_cpu_big0_s0>;
	mem-supply = <&vdd_cpu_big0_mem_s0>;
};

&cpu_b1 {
	cpu-supply = <&vdd_cpu_big0_s0>;
	mem-supply = <&vdd_cpu_big0_mem_s0>;
};

&cpu_b2 {
	cpu-supply = <&vdd_cpu_big1_s0>;
	mem-supply = <&vdd_cpu_big1_mem_s0>;
};

&cpu_b3 {
	cpu-supply = <&vdd_cpu_big1_s0>;
	mem-supply = <&vdd_cpu_big1_mem_s0>;
};

&cpu_l0 {
	cpu-supply = <&vdd_cpu_lit_s0>;
	mem-supply = <&vdd_cpu_lit_mem_s0>;
};

&cpu_l1 {
	cpu-supply = <&vdd_cpu_lit_s0>;
	mem-supply = <&vdd_cpu_lit_mem_s0>;
};

&cpu_l2 {
	cpu-supply = <&vdd_cpu_lit_s0>;
	mem-supply = <&vdd_cpu_lit_mem_s0>;
};

&cpu_l3 {
	cpu-supply = <&vdd_cpu_lit_s0>;
	mem-supply = <&vdd_cpu_lit_mem_s0>;
};

&crypto {
	status = "okay";
};

&display_subsystem {
	clocks = <&hdptxphy_hdmi1>, <&hdptxphy_hdmi0>;
	clock-names = "hdmi1_phy_pll", "hdmi0_phy_pll";
	status = "okay";

	route {
		route_hdmi0: route-hdmi0 {
			status = "okay";
			logo,uboot = "logo.bmp";
			logo,kernel = "logo_kernel.bmp";
			logo,mode = "center";
			charge_logo,mode = "center";
			connect = <&vp0_out_hdmi0>;
		};

		route_hdmi1: route-hdmi1 {
			status = "okay";
			logo,uboot = "logo.bmp";
			logo,kernel = "logo_kernel.bmp";
			logo,mode = "center";
			charge_logo,mode = "center";
			connect = <&vp1_out_hdmi1>;
		};

		route_dp0: route-dp0 {
			status = "okay";
			logo,uboot = "logo.bmp";
			logo,kernel = "logo_kernel.bmp";
			logo,mode = "center";
			charge_logo,mode = "center";
			connect = <&vp2_out_dp0>;
		};

		route_dp1: route-dp1 {
			status = "okay";
			logo,uboot = "logo.bmp";
			logo,kernel = "logo_kernel.bmp";
			logo,mode = "center";
			charge_logo,mode = "center";
			connect = <&vp2_out_dp1>;
		};
	};
};

&dp0 {
	status = "okay";
};

&dp0_in_vp2 {
	status = "okay";
};

&dp1 {
	status = "okay";
};

&dp1_in_vp2 {
	status = "okay";
};

&vp2_out_dp0 {
	status = "okay";
};

&vp2_out_dp1 {
	status = "okay";
};

&gmac1 {
	clock_in_out = "output";
	phy-handle = <&rgmii_phy>;
	phy-mode = "rgmii-rxid";
	pinctrl-0 = <&gmac1_rgmii_bus
				&gmac1_rgmii_clk
				&gmac1_rx_bus2
				&gmac1_tx_bus2
				&gmac1_miim>;
	pinctrl-names = "default";
	snps,reset-active-low;
	snps,reset-delays-us = <0 20000 100000>;
	snps,reset-gpio = <&gpio3 RK_PB7 GPIO_ACTIVE_LOW>;
	rx_delay = <0x00>;
	tx_delay = <0x43>;
	status = "okay";
};

&gpu {
	mali-supply = <&vdd_gpu_s0>;
	mem-supply = <&vdd_gpu_mem_s0>;
	status = "disabled";
};

&gpu_panthor {
	mali-supply = <&vdd_gpu_s0>;
	mem-supply = <&vdd_gpu_mem_s0>;
	status = "okay";
};

&hdmi0 {
	enable-gpios = <&gpio1 RK_PB0 GPIO_ACTIVE_HIGH>;
	cec-enable;
	status = "okay";
};

&hdmi0_in_vp0 {
	status = "okay";
};

&hdptxphy_hdmi0 {
	status = "okay";
};


&vp0_out_hdmi0 {
	status = "okay";
};

&hdmi1 {
	enable-gpios = <&gpio1 RK_PA7 GPIO_ACTIVE_HIGH>;
	cec-enable;
	status = "okay";
};

&hdmi1_in_vp1 {
	status = "okay";
};

&hdptxphy_hdmi1 {
	status = "okay";
};


&vp1_out_hdmi1 {
	status = "okay";
};

&hdmirx_ctrler {
	status = "okay";

	// Effective level used to trigger HPD: 0-low, 1-high
	hpd-trigger-level = <1>;
	hdmirx-det-gpios = <&gpio4 RK_PB0 GPIO_ACTIVE_LOW>;

	pinctrl-names = "default";
	pinctrl-0 = <&hdmim1_rx_cec &hdmim1_rx_hpdin &hdmim1_rx_scl
				 &hdmim1_rx_sda &hdmi_rx_det>;
};

&i2c0 {
	pinctrl-names = "default";
	pinctrl-0 = <&i2c0m2_xfer>;
	status = "okay";

	vdd_cpu_big0_s0: vdd_cpu_big0_mem_s0: regulator@42 {
		compatible = "rockchip,rk8602";
		reg = <0x42>;
		regulator-always-on;
		regulator-boot-on;
		regulator-compatible = "rk860x-reg";
		regulator-max-microvolt = <1050000>;
		regulator-min-microvolt = <550000>;
		regulator-name = "vdd_cpu_big0_s0";
		regulator-ramp-delay = <2300>;
		rockchip,suspend-voltage-selector = <1>;
		vin-supply = <&vcc0_4v0>;

		regulator-state-mem {
			regulator-off-in-suspend;
		};
	};

	vdd_cpu_big1_s0: vdd_cpu_big1_mem_s0: regulator@43 {
		compatible = "rockchip,rk8603", "rockchip,rk8602";
		reg = <0x43>;
		regulator-always-on;
		regulator-boot-on;
		regulator-compatible = "rk860x-reg";
		regulator-max-microvolt = <1050000>;
		regulator-min-microvolt = <550000>;
		regulator-name = "vdd_cpu_big1_s0";
		regulator-ramp-delay = <2300>;
		rockchip,suspend-voltage-selector = <1>;
		vin-supply = <&vcc0_4v0>;

		regulator-state-mem {
			regulator-off-in-suspend;
		};
	};

	hym8563: rtc@51 {
		compatible = "haoyu,hym8563";
		reg = <0x51>;
		#clock-cells = <0>;
		clock-output-names = "hym8563";
		interrupt-parent = <&gpio0>;
		interrupts = <RK_PB0 IRQ_TYPE_LEVEL_LOW>;
		pinctrl-names = "default";
		pinctrl-0 = <&rtc_int>;
		wakeup-source;
		status = "okay";
	};
};

&i2c1 {
	status = "okay";
	pinctrl-names = "default";
	pinctrl-0 = <&i2c1m2_xfer>;

	vdd_npu_s0: vdd_npu_mem_s0: regulator@42 {
		compatible = "rockchip,rk8602";
		reg = <0x42>;
		regulator-always-on;
		regulator-boot-on;
		regulator-compatible = "rk860x-reg";
		regulator-max-microvolt = <950000>;
		regulator-min-microvolt = <550000>;
		regulator-name = "vdd_npu_s0";
		regulator-ramp-delay = <2300>;
		rockchip,suspend-voltage-selector = <1>;
		vin-supply = <&vcc1_5v0>;

		regulator-state-mem {
			regulator-off-in-suspend;
		};
	};

	usbc0: fusb302@22 {
		compatible = "fcs,fusb302";
		reg = <0x22>;
		interrupt-parent = <&gpio0>;
		interrupts = <RK_PB7 IRQ_TYPE_LEVEL_LOW>;
		int-n-gpios = <&gpio0 RK_PB7 GPIO_ACTIVE_LOW>;
		pinctrl-names = "default";
		pinctrl-0 = <&usbc0_int>;
		vbus-supply = <&vbus5v0_typec0>;
		status = "okay";

		ports {
			#address-cells = <1>;
			#size-cells = <0>;

			port@0 {
				reg = <0>;
				usbc0_role_sw: endpoint@0 {
					remote-endpoint = <&dwc3_0_role_switch>;
				};
			};
		};

		usb_con0: connector {
			compatible = "usb-c-connector";
			label = "USB-C0";
			data-role = "dual";
			power-role = "dual";
			try-power-role = "sink";
			op-sink-microwatt = <1000000>;
			sink-pdos =
				<PDO_FIXED(5000, 1000, PDO_FIXED_USB_COMM)
				 PDO_FIXED(9000, 3000, PDO_FIXED_USB_COMM)
				 PDO_FIXED(12000, 3000, PDO_FIXED_USB_COMM)>;
			source-pdos =
				<PDO_FIXED(5000, 3000, PDO_FIXED_USB_COMM)>;

			altmodes {
				#address-cells = <1>;
				#size-cells = <0>;

				altmode@0 {
					reg = <0>;
					svid = <0xff01>;
					vdo = <0xffffffff>;
				};
			};

			ports {
				#address-cells = <1>;
				#size-cells = <0>;

				port@0 {
					reg = <0>;
					usbc0_orien_sw: endpoint {
						remote-endpoint = <&usbdp0_phy0_orientation_switch>;
					};
				};

				port@1 {
					reg = <1>;
					dp0_altmode_mux: endpoint {
						remote-endpoint = <&usbdp0_phy0_dp0_altmode_mux>;
					};
				};
			};
		};
	};

};

&i2c3 {
	status = "okay";

	es8388: es8388@11 {
		#sound-dai-cells = <0>;
		compatible = "everest,es8388", "everest,es8323";
		reg = <0x11>;
		clocks = <&mclkout_i2s0>;
		clock-names = "mclk";
		assigned-clocks = <&mclkout_i2s0>;
		assigned-clock-rates = <12288000>;
		pinctrl-names = "default";
		pinctrl-0 = <&i2s0_mclk>;
		DVDD-supply = <&vcc_1v8_s0>;
		AVDD-supply = <&vcc_3v3_s0>;
		PVDD-supply = <&vcc_1v8_s0>;
		HPVDD-supply = <&vcc_3v3_s0>;
		status = "okay";
	};
};

&i2c6 {
	status = "okay";
	usbc1: fusb302@22 {
		compatible = "fcs,fusb302";
		reg = <0x22>;
		interrupt-parent = <&gpio0>;
		interrupts = <RK_PD3 IRQ_TYPE_LEVEL_LOW>;
		pinctrl-names = "default";
		pinctrl-0 = <&usbc1_int>;
		vbus-supply = <&vbus5v0_typec1>;
		status = "okay";

		ports {
			#address-cells = <1>;
			#size-cells = <0>;

			port@0 {
				reg = <0>;
				usbc1_role_sw: endpoint@0 {
					remote-endpoint = <&dwc3_1_role_switch>;
				};
			};
		};

		usb_con1: connector {
			compatible = "usb-c-connector";
			label = "USB-C1";
			data-role = "dual";
			power-role = "dual";
			try-power-role = "sink";
			op-sink-microwatt = <1000000>;
			sink-pdos =
				<PDO_FIXED(5000, 1000, PDO_FIXED_USB_COMM)>;
			source-pdos =
				<PDO_FIXED(5000, 3000, PDO_FIXED_USB_COMM)>;

			altmodes {
				#address-cells = <1>;
				#size-cells = <0>;

				altmode@0 {
					reg = <0>;
					svid = <0xff01>;
					vdo = <0xffffffff>;
				};
			};

			ports {
				#address-cells = <1>;
				#size-cells = <0>;

				port@0 {
					reg = <0>;
					usbc1_orien_sw: endpoint {
						remote-endpoint = <&usbdp1_phy1_orientation_switch>;
					};
				};

				port@1 {
					reg = <1>;
					dp1_altmode_mux: endpoint {
						remote-endpoint = <&usbdp1_phy1_dp1_altmode_mux>;
					};
				};
			};
		};
	};

	pca9554: gpio@24 {
		compatible = "nxp,pca9554";
		#gpio-cells = <2>;
		gpio-controller;
		reg = <0x24>;
		vcc-supply = <&vcc3v3_io_expander>;
		status = "okay";
	};
};

&i2s0_8ch {
	pinctrl-0 = <&i2s0_lrck
				&i2s0_sclk
				&i2s0_sdi0
				&i2s0_sdo0>;

	status = "okay";
};

&i2s5_8ch {
	status = "okay";
};

&i2s6_8ch {
	status = "okay";
};

&i2s7_8ch {
	status = "okay";
};

&iep {
	status = "okay";
};

&iep_mmu {
	status = "okay";
};

&jpegd {
	status = "okay";
};

&jpegd_mmu {
	status = "okay";
};

&jpege_ccu {
	status = "okay";
};

&jpege0 {
	status = "okay";
};

&jpege0_mmu {
	status = "okay";
};

&jpege1 {
	status = "okay";
};

&jpege1_mmu {
	status = "okay";
};

&jpege2 {
	status = "okay";
};

&jpege2_mmu {
	status = "okay";
};

&jpege3 {
	status = "okay";
};

&jpege3_mmu {
	status = "okay";
};

&mdio1 {
	rgmii_phy: phy@1 {
		compatible = "ethernet-phy-ieee802.3-c22";
		reg = <0x1>;
	};
};

&mpp_srv {
	status = "okay";
};

&pcie2x1l0 {
	reset-gpios = <&gpio4 RK_PA5 GPIO_ACTIVE_HIGH>;
	pinctrl-names = "default";
	pinctrl-0 = <&pcie2_0_rst>;
	rockchip,skip-scan-in-resume;
	status = "okay";
};

&pcie2x1l1 {
	reset-gpios = <&gpio4 RK_PA2 GPIO_ACTIVE_HIGH>;
	pinctrl-names = "default";
	pinctrl-0 = <&pcie2_1_rst>;
	rockchip,skip-scan-in-resume;
	status = "okay";
};

&pcie30phy {
	status = "okay";
};

&pcie3x4 {
	reset-gpios = <&gpio4 RK_PB6 GPIO_ACTIVE_HIGH>;
	pinctrl-names = "default";
	pinctrl-0 = <&pcie3_reset>;
	vpcie3v3-supply = <&vcc3v3_pcie30>;
	status = "okay";
};

&pinctrl {
	hdmiin {
		hdmi_rx_det: hdmi-rx-det {
			rockchip,pins =
				<4 RK_PB0 RK_FUNC_GPIO &pcfg_pull_none>;
		};
	};

	headphone {
		hp_det: hp-det {
			rockchip,pins =
				<1 RK_PC4 RK_FUNC_GPIO &pcfg_pull_none>;
		};
	};

	hym8563 {
		rtc_int: rtc-int {
			rockchip,pins =
				<0 RK_PB0 RK_FUNC_GPIO &pcfg_pull_up>;
		};
	};

	pcie2 {
		pcie2_0_rst: pcie2-0-rst {
			rockchip,pins =
				<4 RK_PA5 RK_FUNC_GPIO &pcfg_pull_none>;
		};

		pcie2_1_rst: pcie2-1-rst {
			rockchip,pins =
				<4 RK_PA2 RK_FUNC_GPIO &pcfg_pull_none>;
		};
	};

	pcie3 {
		pcie3_reset: pcie3-reset {
			rockchip,pins =
				<4 RK_PB6 RK_FUNC_GPIO &pcfg_pull_none>;
		};
	};

	usb-typec {
		usbc0_int: usbc0-int {
			rockchip,pins =
				<0 RK_PB7 RK_FUNC_GPIO &pcfg_pull_up>;
		};

		usbc1_int: usbc1-int {
			rockchip,pins =
				<0 RK_PD3 RK_FUNC_GPIO &pcfg_pull_up>;
		};
	};

	wireless-bluetooth {
		uart9_gpios: uart9-gpios {
			rockchip,pins =
				<4 RK_PC4 RK_FUNC_GPIO &pcfg_pull_none>;
		};

		bt_reset_gpio: bt-reset-gpio {
			rockchip,pins =
				<0 RK_PC6 RK_FUNC_GPIO &pcfg_pull_none>;
		};

		bt_wake_gpio: bt-wake-gpio {
			rockchip,pins =
				<0 RK_PC5 RK_FUNC_GPIO &pcfg_pull_none>;
		};

		bt_irq_gpio: bt-irq-gpio {
			rockchip,pins =
				<0 RK_PC4 RK_FUNC_GPIO &pcfg_pull_none>;
		};
	};

	wireless-wlan {
		sdio_reset_wifi: sdio-reset-wifi {
			rockchip,pins =
				<4 RK_PC6 RK_FUNC_GPIO &pcfg_pull_none>;
		};

		wifi_host_wake_irq: wifi-host-wake-irq {
			rockchip,pins =
				<2 RK_PB4 RK_FUNC_GPIO &pcfg_pull_none>;
		};

		wifi_poweren_gpio: wifi-poweren-gpio {
			rockchip,pins =
				<2 RK_PB5 RK_FUNC_GPIO &pcfg_pull_none>;
		};
	};
};

&rga2 {
	status = "okay";
};

&rga3_core0 {
	status = "okay";
};

&rga3_0_mmu {
	status = "okay";
};

&rga3_core1 {
	status = "okay";
};

&rga3_1_mmu {
	status = "okay";
};

&rknpu {
	rknpu-supply = <&vdd_npu_s0>;
	mem-supply = <&vdd_npu_mem_s0>;
	status = "okay";
};

&rknpu_mmu {
	status = "okay";
};

&rkvdec_ccu {
	status = "okay";
};

&rkvdec0 {
	status = "okay";
};

&rkvdec0_mmu {
	status = "okay";
};

&rkvdec1 {
	status = "okay";
};

&rkvdec1_mmu {
	status = "okay";
};

&rkvenc_ccu {
	status = "okay";
};

&rkvenc0 {
	venc-supply = <&vdd_vdenc_s0>;
	mem-supply = <&vdd_vdenc_mem_s0>;
	status = "okay";
};

&rkvenc0_mmu {
	status = "okay";
};

&rkvenc1 {
	venc-supply = <&vdd_vdenc_s0>;
	mem-supply = <&vdd_vdenc_mem_s0>;
	status = "okay";
};

&rkvenc1_mmu {
	status = "okay";
};

&rng {
	status = "okay";
};

&rockchip_suspend {
	status = "okay";
	rockchip,sleep-debug-en = <1>;
	rockchip,virtual-poweroff = <1>;
	rockchip,sleep-mode-config = <
		(0
		| RKPM_SLP_ARMOFF_DDRPD
		| RKPM_SLP_PMU_PMUALIVE_32K
		| RKPM_SLP_PMU_DIS_OSC
		| RKPM_SLP_32K_EXT
		| RKPM_SLP_PMU_DBG
		)
	>;

	rockchip,wakeup-config = <
		(0
		| RKPM_CPU0_WKUP_EN
		| RKPM_GPIO_WKUP_EN
		)
	>;
};

&saradc {
	vref-supply = <&avcc_1v8_s0>;
	status = "okay";
};

&sdhci {
	bus-width = <8>;
	full-pwr-cycle-in-suspend;
	max-frequency = <200000000>;
	mmc-hs400-1_8v;
	mmc-hs400-enhanced-strobe;
	no-sd;
	no-sdio;
	non-removable;
	status = "okay";
};

&sdmmc {
	bus-width = <4>;
	cap-mmc-highspeed;
	cap-sd-highspeed;
	disable-wp;
	max-frequency = <150000000>;
	no-mmc;
	no-sdio;
	status = "okay";
};

&sdio {
	max-frequency = <150000000>;
	no-sd;
	no-mmc;
	bus-width = <4>;
	disable-wp;
	cap-sd-highspeed;
	cap-sdio-irq;
	keep-power-in-suspend;
	mmc-pwrseq = <&sdio_pwrseq>;
	non-removable;
	pinctrl-names = "default";
	pinctrl-0 = <&sdiom0_pins>;
	vmmc-supply = <&vcc_3v3_s3>;
	vqmmc-supply = <&vcc_1v8_s3>;
	status = "okay";
};

&spdif_tx2 {
	status = "okay";
};

&spdif_tx5 {
	status = "okay";
};

&tsadc {
	status = "okay";
};

&sata0 {
	status = "okay";
};

&u2phy0 {
	status = "okay";
};

&u2phy0_otg {
	rockchip,typec-vbus-det;
	status = "okay";
};

&u2phy1 {
	status = "okay";
};

&u2phy1_otg {
	rockchip,typec-vbus-det;
	status = "okay";
};

&u2phy2 {
	status = "okay";
};

&u2phy2_host {
	phy-supply = <&vcc5v0_usb20_host>;
	status = "okay";
};

&u2phy3 {
	status = "okay";
};

&u2phy3_host {
	phy-supply = <&vcc5v0_usb20_host>;
	status = "okay";
};

&uart9 {
	pinctrl-names = "default";
	pinctrl-0 = <&uart9m0_xfer &uart9m0_ctsn>;
	status = "okay";
};

&usb_host0_ehci {
	status = "okay";
};

&usb_host0_ohci {
	status = "okay";
};

&usb_host1_ehci {
	status = "okay";
};

&usb_host1_ohci {
	status = "okay";
};

&usbdp_phy0 {
	status = "okay";
	orientation-switch;

	svid = <0xff01>;
	sbu1-dc-gpios = <&gpio4 RK_PA6 GPIO_ACTIVE_HIGH>;
	sbu2-dc-gpios = <&gpio4 RK_PA7 GPIO_ACTIVE_HIGH>;

	port {
		#address-cells = <1>;
		#size-cells = <0>;

		usbdp0_phy0_orientation_switch: endpoint@0 {
			reg = <0>;
			remote-endpoint = <&usbc0_orien_sw>;
		};

		usbdp0_phy0_dp0_altmode_mux: endpoint@1 {
			reg = <1>;
			remote-endpoint = <&dp0_altmode_mux>;
		};
	};
};

&usbdp_phy0_dp {
	status = "okay";
};

&usbdp_phy0_u3 {
	status = "okay";
};

&usbdp_phy1 {
	status = "okay";
	orientation-switch;

	svid = <0xff01>;
	sbu1-dc-gpios = <&gpio4 RK_PB1 GPIO_ACTIVE_HIGH>;
	sbu2-dc-gpios = <&gpio4 RK_PB3 GPIO_ACTIVE_HIGH>;

	port {
		#address-cells = <1>;
		#size-cells = <0>;

		usbdp1_phy1_orientation_switch: endpoint@0 {
			reg = <0>;
			remote-endpoint = <&usbc1_orien_sw>;
		};

		usbdp1_phy1_dp1_altmode_mux: endpoint@1 {
			reg = <1>;
			remote-endpoint = <&dp1_altmode_mux>;
		};
	};
};

&usbdp_phy1_dp {
	status = "okay";
};

&usbdp_phy1_u3 {
	status = "okay";
};

&usbdrd3_0 {
	status = "okay";
};

&usbdrd_dwc3_0 {
	dr_mode = "otg";
	status = "okay";
	usb-role-switch;

	ports {
		#address-cells = <1>;
		#size-cells = <0>;

		port@1 {
			reg = <1>;
			#address-cells = <1>;
			#size-cells = <0>;

			dwc3_0_role_switch: endpoint@0 {
				reg = <0>;
				remote-endpoint = <&usbc0_role_sw>;
			};
		};
	};
};

&usbhost3_0 {
	status = "okay";
};

&usbhost_dwc3_0 {
	dr_mode = "otg";
	status = "okay";
};

&usbdrd3_1 {
	status = "okay";
};

&usbdrd_dwc3_1 {
	dr_mode = "otg";
	status = "okay";
	usb-role-switch;

	ports {
		#address-cells = <1>;
		#size-cells = <0>;

		port@1 {
			reg = <1>;
			#address-cells = <1>;
			#size-cells = <0>;

			dwc3_1_role_switch: endpoint@0 {
				reg = <0>;
				remote-endpoint = <&usbc1_role_sw>;
			};
		};
	};
};

&vdpu {
	status = "okay";
};

&vdpu_mmu {
	status = "okay";
};

&vepu {
	status = "okay";
};

&vop {
	status = "okay";
};

&vop_mmu {
	status = "okay";
};

&vp0 {
	rockchip,plane-mask = <(1 << ROCKCHIP_VOP2_CLUSTER0 | 1 << ROCKCHIP_VOP2_ESMART0)>;
	rockchip,primary-plane = <ROCKCHIP_VOP2_CLUSTER0>;
	cursor-win-id = <ROCKCHIP_VOP2_ESMART0>;
};

&vp1 {
	rockchip,plane-mask = <(1 << ROCKCHIP_VOP2_CLUSTER1 | 1 << ROCKCHIP_VOP2_ESMART1)>;
	rockchip,primary-plane = <ROCKCHIP_VOP2_CLUSTER1>;
	cursor-win-id = <ROCKCHIP_VOP2_ESMART1>;
};

&vp2 {
	rockchip,plane-mask = <(1 << ROCKCHIP_VOP2_CLUSTER2 | 1 << ROCKCHIP_VOP2_ESMART2)>;
	rockchip,primary-plane = <ROCKCHIP_VOP2_CLUSTER2>;
	cursor-win-id = <ROCKCHIP_VOP2_ESMART2>;
};

&vp3 {
	rockchip,plane-mask = <(1 << ROCKCHIP_VOP2_CLUSTER3 | 1 << ROCKCHIP_VOP2_ESMART3)>;
	rockchip,primary-plane = <ROCKCHIP_VOP2_CLUSTER3>;
	cursor-win-id = <ROCKCHIP_VOP2_ESMART3>;
};
